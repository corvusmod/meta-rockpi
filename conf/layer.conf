## conf/layer.conf
```bitbake
# We have a conf and classes directory, add to BBPATH
BBPATH .= ":${LAYERDIR}"

# We have a packages directory, add to BBFILES
BBFILES += "${LAYERDIR}/recipes-*/*/*.bb \
            ${LAYERDIR}/recipes-*/*/*.bbappend"

BBFILE_COLLECTIONS += "rockpi-s"
BBFILE_PATTERN_rockpi-s := "^${LAYERDIR}/"
BBFILE_PRIORITY_rockpi-s = "6"

LAYERSERIES_COMPAT_rockpi-s = "warrior"
```

## conf/machine/rockpi-s.conf
```bitbake
#@TYPE: Machine
#@NAME: RockPi S
#@SOC: Rockchip RK3308
#@DESCRIPTION: Machine configuration for RockPi S

require conf/machine/include/tune-cortexa35.inc
require conf/machine/include/soc-family.inc

SOC_FAMILY = "rk3308"

PREFERRED_PROVIDER_virtual/bootloader = "u-boot-rockpi-s"

PREFERRED_PROVIDER_virtual/kernel = "linux-rockpi-s"

PREFERRED_VERSION_linux-rockchip = "4.4"

UBOOT_MACHINE = "rockpi-s-rk3308_defconfig"

SERIAL_CONSOLES = "1500000;ttyFIQ0"

KERNEL_IMAGETYPE = "Image"

KBUILD_DEFCONFIG = "rockchip_linux_defconfig"

KERNEL_DEVICETREE = "rockchip/rk3399-nanopi4-rev00.dtb"

MACHINE_ESSENTIAL_EXTRA_RDEPENDS += "kernel-devicetree"
```
